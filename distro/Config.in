## distro/configs/leon_qemu_aarch64_defconfig
```kconfig
BR2_aarch64=y
BR2_TOOLCHAIN_EXTERNAL=y
BR2_TOOLCHAIN_EXTERNAL_BOOTLIN=y
BR2_TOOLCHAIN_EXTERNAL_BOOTLIN_AARCH64_MUSL_STABLE=y
BR2_REPRODUCIBLE=y
BR2_GLOBAL_PATCH_DIR="$(BR2_EXTERNAL_LEON_PATH)/patches"
BR2_TARGET_GENERIC_HOSTNAME="leonmobile"
BR2_TARGET_GENERIC_ISSUE="LeonMobile 1.0.0"
BR2_INIT_NONE=y
BR2_ROOTFS_DEVICE_CREATION_DYNAMIC_EUDEV=y
BR2_TARGET_GENERIC_ROOT_PASSWD="!"
# BR2_TARGET_GENERIC_GETTY is not set
BR2_ROOTFS_OVERLAY="$(BR2_EXTERNAL_LEON_PATH)/rootfs-overlay"
BR2_ROOTFS_POST_BUILD_SCRIPT="$(BR2_EXTERNAL_LEON_PATH)/board/qemu-arm64/post-build.sh"
BR2_ROOTFS_POST_IMAGE_SCRIPT="$(BR2_EXTERNAL_LEON_PATH)/board/qemu-arm64/post-image.sh"
BR2_ROOTFS_USERS_TABLES="$(BR2_EXTERNAL_LEON_PATH)/board/qemu-arm64/users.txt"
BR2_LINUX_KERNEL=y
BR2_LINUX_KERNEL_CUSTOM_VERSION=y
BR2_LINUX_KERNEL_CUSTOM_VERSION_VALUE="7.3.1"
BR2_LINUX_KERNEL_USE_CUSTOM_CONFIG=y
BR2_LINUX_KERNEL_CUSTOM_CONFIG_FILE="$(BR2_EXTERNAL_LEON_PATH)/board/qemu-arm64/linux.config"
BR2_LINUX_KERNEL_CONFIG_FRAGMENT_FILES="$(BR2_EXTERNAL_LEON_PATH)/board/qemu-arm64/linux.fragment"
BR2_LINUX_KERNEL_NEEDS_HOST_OPENSSL=y
BR2_PACKAGE_LEONMOBILE=y
BR2_PACKAGE_WAYLAND=y
BR2_PACKAGE_WAYLAND_PROTOCOLS=y
BR2_PACKAGE_MESA3D=y
BR2_PACKAGE_MESA3D_GALLIUM_DRIVER_SOFTPIPE=y
BR2_PACKAGE_MESA3D_GALLIUM_DRIVER_VIRGL=y
BR2_PACKAGE_MESA3D_OPENGL_EGL=y
BR2_PACKAGE_MESA3D_OPENGL_ES=y
BR2_PACKAGE_WLROOTS=y
BR2_PACKAGE_SEATD=y
BR2_PACKAGE_SEATD_DAEMON=y
BR2_PACKAGE_CAIRO=y
BR2_PACKAGE_CAIRO_PNG=y
BR2_PACKAGE_PANGO=y
BR2_PACKAGE_WQY_ZENHEI=y
BR2_PACKAGE_DEJAVU=y
BR2_PACKAGE_JSON_FOR_MODERN_CPP=y
BR2_PACKAGE_LIBARCHIVE=y
BR2_PACKAGE_LIBARCHIVE_BSDTAR=y
BR2_PACKAGE_OPENSSL=y
BR2_PACKAGE_LIBVTERM_LEON=y
BR2_PACKAGE_LIBJPEG_TURBO=y
BR2_PACKAGE_PIPEWIRE=y
BR2_PACKAGE_ALSA_LIB=y
BR2_PACKAGE_ALSA_UTILS=y
BR2_PACKAGE_ALSA_UTILS_APLAY=y
BR2_PACKAGE_LUA=y
BR2_PACKAGE_LUA_5_4=y
BR2_PACKAGE_WIREPLUMBER=y
BR2_PACKAGE_DBUS=y
BR2_PACKAGE_IPROUTE2=y
BR2_TARGET_ROOTFS_EXT2=y
BR2_TARGET_ROOTFS_EXT2_4=y
BR2_TARGET_ROOTFS_EXT2_SIZE="768M"
BR2_TARGET_ROOTFS_EXT2_LABEL="leon-system"
# BR2_TARGET_ROOTFS_TAR is not set
BR2_PACKAGE_HOST_GENIMAGE=y
BR2_PACKAGE_HOST_DOSFSTOOLS=y
BR2_PACKAGE_HOST_MTOOLS=y
```

## distro/package/leon-apps/Config.in
```kconfig
config BR2_PACKAGE_LEON_APPS
	bool "LeonMobile native built-in applications"
	depends on BR2_TOOLCHAIN_GCC_AT_LEAST_10
	depends on BR2_USE_WCHAR
	depends on !BR2_STATIC_LIBS
	depends on BR2_INSTALL_LIBSTDCPP
	depends on BR2_TOOLCHAIN_HAS_THREADS
	depends on BR2_USE_MMU
	depends on BR2_TOOLCHAIN_HAS_SYNC_4
	depends on BR2_TOOLCHAIN_HEADERS_AT_LEAST_4_14
	select BR2_PACKAGE_LMUI
	select BR2_PACKAGE_JSON_FOR_MODERN_CPP
	select BR2_PACKAGE_LIBVTERM_LEON
	select BR2_PACKAGE_JPEG
```

## distro/package/leon-core/Config.in
```kconfig
config BR2_PACKAGE_LEON_CORE
	bool "LeonMobile core services and tools"
	depends on BR2_TOOLCHAIN_GCC_AT_LEAST_10
	depends on BR2_USE_WCHAR
	depends on BR2_INSTALL_LIBSTDCPP
	depends on BR2_TOOLCHAIN_HAS_THREADS
	select BR2_PACKAGE_JSON_FOR_MODERN_CPP
	select BR2_PACKAGE_LIBARCHIVE
	select BR2_PACKAGE_OPENSSL
```

## distro/package/leon-pinyin/Config.in
```kconfig
config BR2_PACKAGE_LEON_PINYIN
	bool "LeonMobile pinyin dictionary"
	help
	  Deterministic candidates generated from Unicode 17.0.0 Unihan.
```

## distro/package/leonmobile/Config.in
```kconfig
config BR2_PACKAGE_LEONMOBILE
	bool "LeonMobile reference distribution"
	depends on BR2_TOOLCHAIN_GCC_AT_LEAST_10
	depends on BR2_USE_WCHAR
	depends on !BR2_STATIC_LIBS
	depends on BR2_PACKAGE_HAS_UDEV
	depends on BR2_PACKAGE_HAS_LIBGBM
	depends on BR2_aarch64
	depends on BR2_TOOLCHAIN_USES_MUSL
	depends on BR2_INSTALL_LIBSTDCPP
	depends on BR2_TOOLCHAIN_HAS_THREADS
	depends on BR2_USE_MMU
	depends on BR2_TOOLCHAIN_HAS_ATOMIC
	depends on BR2_PACKAGE_HAS_LIBEGL
	depends on BR2_PACKAGE_HAS_LIBGLES
	depends on BR2_TOOLCHAIN_HAS_SYNC_4
	depends on BR2_TOOLCHAIN_HEADERS_AT_LEAST_4_14
	select BR2_PACKAGE_LEON_CORE
	select BR2_PACKAGE_LMUI
	select BR2_PACKAGE_LEON_DESKTOP
	select BR2_PACKAGE_LEON_APPS
	help
	  LeonMobile 1.0.0 QEMU developer graphics prototype.
	  Selects independently built core, UI runtime, desktop
	  and built-in application packages.

source "$BR2_EXTERNAL_LEON_PATH/package/leon-core/Config.in"
source "$BR2_EXTERNAL_LEON_PATH/package/lmui/Config.in"
source "$BR2_EXTERNAL_LEON_PATH/package/leon-desktop/Config.in"
source "$BR2_EXTERNAL_LEON_PATH/package/leon-apps/Config.in"

config BR2_PACKAGE_LIBVTERM_LEON
	bool "libvterm (LeonMobile terminal dependency)"
	select BR2_PACKAGE_LIBICONV if !BR2_ENABLE_LOCALE
```

## distro/package/lmui/Config.in
```kconfig
config BR2_PACKAGE_LMUI
	bool "LMUI native UI runtime and SDK"
	depends on BR2_TOOLCHAIN_GCC_AT_LEAST_10
	depends on BR2_USE_WCHAR
	depends on !BR2_STATIC_LIBS
	depends on BR2_INSTALL_LIBSTDCPP
	depends on BR2_TOOLCHAIN_HAS_THREADS
	depends on BR2_USE_MMU
	depends on BR2_TOOLCHAIN_HAS_SYNC_4
	depends on BR2_TOOLCHAIN_HEADERS_AT_LEAST_4_14
	select BR2_PACKAGE_WAYLAND
	select BR2_PACKAGE_WAYLAND_PROTOCOLS
	select BR2_PACKAGE_CAIRO
	select BR2_PACKAGE_CAIRO_PNG
	select BR2_PACKAGE_PANGO
	select BR2_PACKAGE_LIBXKBCOMMON
	select BR2_PACKAGE_XKEYBOARD_CONFIG
```
